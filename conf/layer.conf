## conf/layer.conf
```bitbake
BBPATH .= ":${LAYERDIR}"

BBFILES += "${LAYERDIR}/recipes-*/*/*.bb \
            ${LAYERDIR}/recipes-*/*/*.bbappend"

BBFILE_COLLECTIONS += "edge-imx-image"
BBFILE_PATTERN_edge-imx-image = "^${LAYERDIR}/"
BBFILE_PRIORITY_edge-imx-image = "7"

LAYERSERIES_COMPAT_edge-imx-image = "dunfell gatesgarth hardknott kirkstone langdale zeus scarthgap wrynose"
```

## conf/machine/edge-am62lxx-libra.conf
```bitbake
require conf/machine/am62lxx-libra-fpsc-1.conf
MACHINEOVERRIDES =. "am62lxx-libra-fpsc-1:"
MACHINE_FEATURES:append = " snapd"
DEFAULTTUNE = "cortexa53-crypto"
```

## conf/machine/edge-imx6ul-tauri-s.conf
```bitbake
require conf/machine/phygate-tauri-s-imx6ul-1.conf
MACHINEOVERRIDES =. "phygate-tauri-s-imx6ul-1:"
MACHINE_FEATURES:append = " snapd"
```

## conf/machine/edge-imx8mm-polis.conf
```bitbake
require conf/machine/phyboard-polis-imx8mm-5.conf
MACHINEOVERRIDES =. "phyboard-polis-imx8mm-5:"
MACHINE_FEATURES:append = " snapd"
```

## conf/machine/edge-imx8mm-tauri-l.conf
```bitbake
require conf/machine/phygate-tauri-l-imx8mm-2.conf  
MACHINEOVERRIDES =. "phygate-tauri-l-imx8mm-2:"
MACHINE_FEATURES:append = " snapd"
```

## conf/machine/edge-imx8mp-pollux.conf
```bitbake
require conf/machine/phyboard-pollux-imx8mp-3.conf
MACHINEOVERRIDES =. "phyboard-pollux-imx8mp-3:"
MACHINE_FEATURES:append = " snapd"
```

## conf/machine/edge-imx93-nash.conf
```bitbake
require conf/machine/phyboard-nash-imx93-1.conf
MACHINEOVERRIDES =. "phyboard-nash-imx93-1:"
MACHINE_FEATURES:append = " snapd"
```

## conf/machine/edge-imx93-segin.conf
```bitbake
require conf/machine/phyboard-segin-imx93-2.conf
MACHINEOVERRIDES =. "phyboard-segin-imx93-2:"
MACHINE_FEATURES:append = " snapd"
```

## conf/machine/edge-imx93-yo.conf
```bitbake
require conf/machine/phyboard-segin-imx93-2.conf
MACHINE_FEATURES:append = " snapd"
```

## recipes-connectivity/wpa-supplicant/files/defconfig
```kconfig
CONFIG_CTRL_IFACE=y
CONFIG_CTRL_IFACE_UNIX=y
CONFIG_WPA=y
CONFIG_WPA2=y
CONFIG_DRIVER_NL80211=y
```
